## BaseDeployment/config/kconfig/Kconfig.debug
```kconfig
menu "Debugging & Logging"

config FPRIME_ASSERT
    bool "Enable assertions"
    default y
    select ASSERT
    help
      Enable runtime assertions for error detection

config FPRIME_LOGGING
    bool "Enable logging"
    default y
    select LOG
    help
      Enable system logging capabilities

if FPRIME_LOGGING
    choice FPRIME_LOG_LEVEL
        prompt "Default Log Level"
        default FPRIME_LOG_LEVEL_INFO

        config FPRIME_LOG_LEVEL_ERR
            bool "Error"

        config FPRIME_LOG_LEVEL_WRN
            bool "Warning"

        config FPRIME_LOG_LEVEL_INFO
            bool "Info"

        config FPRIME_LOG_LEVEL_DBG
            bool "Debug"
    endchoice

    config FPRIME_LOG_BUFFER_SIZE
        int "Log buffer size"
        default 512
        help
          Size of the logging buffer in bytes
endif

config FPRIME_STACK_PROTECTION
    bool "Enable stack protection"
    default y
    select MPU_STACK_GUARD
    help
      Enable memory protection for stacks

config FPRIME_RUNTIME_ANALYSIS
    bool "Enable runtime analysis"
    default n
    select THREAD_RUNTIME_STATS if y
    select THREAD_MONITOR if y
    select THREAD_STACK_INFO if y
    select STACK_USAGE if y
    select THREAD_NAME if y
    help
      Enable runtime analysis features for debugging

endmenu
```

## BaseDeployment/config/kconfig/Kconfig.fprime
```kconfig
menu "F' Configuration"

config FPRIME_RUNTIME
    bool "Enable F' Framework"
    default y
    select NEWLIB_LIBC
    select REQUIRES_FULL_LIBCPP
    help
      Enables the F' flight software framework

config FPRIME_HEAP_SIZE
    int "F' heap size (bytes)"
    default 128000
    help
      Size of heap memory pool available to F' components

config FPRIME_HEAP_SIZE
    int "F' heap size (bytes)"
    default 128000
    help
      Size of heap memory pool available to F' components

config FPRIME_MAIN_STACK
    int "Main stack size (bytes)"
    default 16384
    help
      Size of main thread stack for F' application

config FPRIME_USB_CONSOLE
    bool "Use USB for console"
    default y
    select USB_DEVICE_STACK
    select USB_CDC_ACM
    select USB_DEVICE_INITIALIZE_AT_BOOT
    help
      Enable USB CDC-ACM as the console interface

if FPRIME_USB_CONSOLE
    config FPRIME_USB_PRODUCT
        string "USB Product Name"
        default "SAM V71 F'"

    config FPRIME_USB_MANUFACTURER
        string "USB Manufacturer Name"
        default "Atmel"
endif

endmenu
```

## BaseDeployment/config/kconfig/Kconfig.hardware
```kconfig
menu "Hardware Peripherals"

config SERIAL
    bool "Serial Communications"
    default y
    select SERIAL
    select UART_INTERRUPT_DRIVEN
    select UART_CONSOLE
    select UART_LINE_CTRL
    help
      Enable serial communications interfaces

config GPIO
    bool "GPIO Support"
    default y
    select GPIO
    help
      Enable general purpose I/O

config PWM
    bool "PWM Support"
    default y
    select PWM
    help
      Enable pulse width modulation

config I2C
    bool "I2C Support"
    default y
    select I2C
    help
      Enable I2C bus interfaces

config SPI
    bool "SPI Support"
    default y
    select SPI
    help
      Enable SPI bus interfaces

config PINCTRL
    bool "Pin Control"
    default y
    select PINCTRL
    help
      Enable pin controller for hardware IO configuration

config FPU
    bool "Floating Point Support"
    default y
    select FPU
    select FPU_SHARING
    help
      Enable hardware floating point support

config FILESYSTEM
    bool "Filesystem Support"
    default n
    select FLASH
    select FLASH_MAP
    select FLASH_PAGE_LAYOUT
    select FILE_SYSTEM
    select FILE_SYSTEM_LITTLEFS
    help
      Enable filesystem support for data storage

endmenu
```

## bare-zephyr-ref/west.yml
```yaml
manifest:
  version: 0.12
  self:
    path: smoketest
  projects:
    - name: zephyr
      url: https://github.com/zephyrproject-rtos/zephyr
      revision: v4.0.0
      clone-depth: 1
      import:
        path-prefix: deps
        name-allowlist:
          - hal_atmel
          - cmsis
          - cmsis_6
```

## west.yml
```yaml
manifest:
  version: 0.12
  self:
    path: .
  projects:
    - name: zephyr
      # This ensures west has access to zephyrs extensions
      west-commands: scripts/west-commands.yml
      url: https://github.com/zephyrproject-rtos/zephyr
      revision: v4.1-branch
      clone-depth: 1
      import:
        path-prefix: deps
        name-allowlist:
          - hal_atmel
          - cmsis
          - cmsis_6
```
